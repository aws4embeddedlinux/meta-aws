## conf/layer.conf
```bitbake
# -*- mode: Conf; -*-
# We have a conf and classes directory, add to BBPATH
BBPATH .= ":${LAYERDIR}"

# We have recipes-* directories, add to BBFILES
BBFILES += "${LAYERDIR}/recipes-*/*/*.bb \
            ${LAYERDIR}/recipes-*/*/*.bbappend"
BBFILES += "${@bb.utils.contains("GG_KERNEL_MOD", "Y", "${LAYERDIR}/recipes-*/*/base/*.bbappend", "", d)}"

BBFILE_COLLECTIONS += "meta-aws"
BBFILE_PATTERN_meta-aws = "^${LAYERDIR}/"
BBFILE_PRIORITY_meta-aws = "6"

LAYERDEPENDS_meta-aws += "core"
LAYERDEPENDS_meta-aws += "openembedded-layer"
LAYERDEPENDS_meta-aws += "networking-layer"
LAYERDEPENDS_meta-aws += "meta-python"

LAYERSERIES_COMPAT_meta-aws = "honister"

# This is necessary to enable if you are using greengrass-lite, as greengrass lite require a recent version of
# cmake, openssl, curl
# ENABLE_GREENGRASS_LITE_MIXINS = "1"
BBFILES_DYNAMIC += "\
    ${@bb.utils.contains("ENABLE_GREENGRASS_LITE_MIXINS", "1", " \
    core:${LAYERDIR}/dynamic-layers/mixin-cmake_curl_openssl-layer/*/*/*.bb \
    core:${LAYERDIR}/dynamic-layers/mixin-cmake_curl_openssl-layer/*/*/*.bbappend \
    ", "", d)} \
"
```

## conf/machine/aws-ec2-arm64.conf
```bitbake
#@TYPE: Machine
#@NAME: aws ec2 arm64
#@DESCRIPTION: AWS arm 64 processer ec2 type

require conf/machine/include/aws-ec2-base.inc

require conf/machine/include/arm/arch-armv8-2a.inc

PREFERRED_PROVIDER_virtual/kernel ?= "linux-yocto"

KBUILD_DEFCONFIG = "defconfig"
KCONFIG_MODE = "--alldefconfig"

KERNEL_IMAGETYPE = "Image"
MACHINE_EXTRA_RRECOMMENDS += "kernel-modules linux-firmware"

EFI_PROVIDER ?= "${@bb.utils.contains("DISTRO_FEATURES", "systemd", "systemd-boot", "grub-efi", d)}"

WKS_FILE_DEPENDS_BOOTLOADERS:aarch64 += "systemd-boot"

WKS_FILE ?= "efi-disk.wks.in"

MACHINE_FEATURES:append = " efi rtc"
```

## conf/machine/aws-ec2-x86-64.conf
```bitbake
#@TYPE: Machine
#@NAME: aws ec2 x86-64
#@DESCRIPTION: AWS x86-64 processer ec2 type

require conf/machine/include/aws-ec2-base.inc

DEFAULTTUNE ?= "core2-64"
require conf/machine/include/x86/tune-core2.inc
include conf/machine/include/x86/x86-base.inc

PREFERRED_VERSION_linux-yocto ?= "5.15%"
PREFERRED_PROVIDER_virtual/kernel ?= "linux-yocto"

MACHINE_EXTRA_RRECOMMENDS += "kernel-modules linux-firmware"

SERIAL_CONSOLES_CHECK = "ttyS0"

EFI_PROVIDER ?= "${@bb.utils.contains("DISTRO_FEATURES", "systemd", "systemd-boot", "grub-efi", d)}"

WKS_FILE ?= "efi-disk.wks.in"

KMACHINE ?= "common-pc-64"
```

## qa/checklayer/conf/bblayers.conf
```bitbake
# POKY_BBLAYERS_CONF_VERSION is increased each time build/conf/bblayers.conf
# changes incompatibly
POKY_BBLAYERS_CONF_VERSION = "2"

BBPATH = "${TOPDIR}"
BBFILES ?= ""

BBLAYERS ?= " \
  DIST/poky/meta \
  DIST/poky/meta-poky \
  DIST/poky/meta-yocto-bsp \
  "
```
